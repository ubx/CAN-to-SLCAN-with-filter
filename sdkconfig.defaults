## sdkconfig.defaults
```kconfig
CONFIG_TINYUSB_ENABLED=y
CONFIG_TINYUSB_CDC_ENABLED=y
CONFIG_USB_DEVICE_ENABLED=y
CONFIG_USB_OTG_SUPPORTED=y
CONFIG_TWAI_ISR_IN_IRAM=y
CONFIG_ESPTOOLPY_FLASHSIZE_16MB=y

# Enable BLE NimBLE stack when BLE is used (esp32-s3-zero env defines -DENABLE_BLE)
CONFIG_BT_ENABLED=y
CONFIG_BT_BLE_ENABLED=y
CONFIG_BT_NIMBLE_ENABLED=y
CONFIG_BT_NIMBLE_ROLE_PERIPHERAL=y
CONFIG_BT_NIMBLE_SVC_GAP=y
CONFIG_BT_NIMBLE_SVC_GATT=y
CONFIG_BT_BLUEDROID_ENABLED=n

CONFIG_BT_NIMBLE_MAX_CONNECTIONS=1
CONFIG_BT_NIMBLE_MSYS_1_BLOCK_COUNT=128
CONFIG_BT_NIMBLE_MSYS_1_BLOCK_SIZE=292
CONFIG_BT_NIMBLE_MSYS_2_BLOCK_COUNT=24
CONFIG_BT_NIMBLE_MSYS_2_BLOCK_SIZE=660

# Allow more pending notifications
CONFIG_BT_NIMBLE_HS_FLOW_CTRL=y
CONFIG_BT_NIMBLE_HS_FLOW_CTRL_ITVL=100
CONFIG_BT_NIMBLE_HS_FLOW_CTRL_THRESH=2
```
